## conf/layer.conf
```bitbake
# We have a conf and classes directory, append to BBPATH
BBPATH .= ":${LAYERDIR}"

# We have a recipes directory, add to BBFILES
BBFILES += "${LAYERDIR}/recipes-*/*/*.bb \
            ${LAYERDIR}/recipes-*/*/*.bbappend"

BBFILE_COLLECTIONS += "iot-hub-device-update-delta"
BBFILE_PATTERN_iot-hub-device-update-delta := "^${LAYERDIR}/"
BBFILE_PRIORITY_iot-hub-device-update-delta = "6"

LAYERVERSION_iot-hub-device-update-delta = "1"
LAYERSERIES_COMPAT_iot-hub-device-update-delta = "scarthgap"

# Only include delta update recipes if WITH_FEATURE_DELTA_UPDATE is set to "1"
# Default is "1" (enabled)
WITH_FEATURE_DELTA_UPDATE ?= "1"

# Conditionally set layer dependencies - only needed when delta updates are enabled
# Make dependencies empty when feature is disabled
LAYERDEPENDS_iot-hub-device-update-delta = "${@'core openembedded-layer networking-layer clang-layer' if d.getVar('WITH_FEATURE_DELTA_UPDATE') == '1' else 'core'}"

# Mask all recipes in this layer if delta updates are disabled
BBMASK .= "${@'|meta-iot-hub-device-update-delta' if d.getVar('WITH_FEATURE_DELTA_UPDATE') != '1' else ''}"
```
